## defconfig
```kconfig
###########################################
# Zybo Options
###########################################
#BR2_TARGET_UBOOT_BOARD_DEFCONFIG="zynq_zyboz7"
#BR2_PACKAGE_XILINX_BOOTLOADER_UBOOT_TARGET_DIR="board/xilinx/zynq/zynq-zyboz7"
BR2_TARGET_UBOOT_CUSTOM_REPO_URL="https://github.com/svanbeek1970/xilinx-uboot.git"
BR2_TARGET_UBOOT_CUSTOM_REPO_VERSION="mathworks_zyboz7_R17.2.0"

#Custom kernel config
BR2_LINUX_KERNEL_CONFIG_FRAGMENT_FILES="board/mathworks/zynq/boards/zyboz7/kconfig"
```
